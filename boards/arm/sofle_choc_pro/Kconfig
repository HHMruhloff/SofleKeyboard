## boards/arm/sofle_choc_pro/Kconfig.defconfig
```kconfig
if BOARD_SOFLE_CHOC_PRO_LEFT || BOARD_SOFLE_CHOC_PRO_RIGHT

config BOARD
    default "sofle_choc_pro_left" if BOARD_SOFLE_CHOC_PRO_LEFT
    default "sofle_choc_pro_right" if BOARD_SOFLE_CHOC_PRO_RIGHT

# Das hier hilft Zephyr, den richtigen SoC-Kconfig-Pfad zu finden
config SOC_SERIES_NRF52X
    default y
    depends on SOC_NRF52840_QIAA

endif
```

## boards/arm/sofle_choc_pro/sofle_choc_pro_left_defconfig
```kconfig
CONFIG_SOC_SERIES_NRF52X=y
CONFIG_SOC_NRF52840_QIAA=y
CONFIG_BOARD_SOFLE_CHOC_PRO_LEFT=y
```

## boards/arm/sofle_choc_pro_left/board.yml
```yaml
board:
  name: sofle_choc_pro_left
  vendor: custom
  full_name: Sofle Choc Pro Left
  revision:
    format: major.minor.patch
    default: 1.0.0

build:
  soc: nrf52840_qiaa
```

## boards/shields/sofle_choc_pro/Kconfig.shield
```kconfig
config SHIELD_SOFLE_CHOC_PRO_LEFT
    def_bool $(shields_list_contains,sofle_choc_pro_left)

config SHIELD_SOFLE_CHOC_PRO_RIGHT
    def_bool $(shields_list_contains,sofle_choc_pro_right)
```

## boards/sofle_choc_pro/Kconfig
```kconfig
config BOARD_SOFLE_CHOC_PRO_LEFT
    def_bool $(boards_lowlevel_ok,sofle_choc_pro_left)

config BOARD_SOFLE_CHOC_PRO_RIGHT
    def_bool $(boards_lowlevel_ok,sofle_choc_pro_right)
```

## boards/sofle_choc_pro/board.yml
```yaml
board:
  name: sofle_choc_pro
  vendor: custom
  soc: nrf52840
  identifier: sofle_choc_pro
  type: board
  arch: arm
  revisions:
    - name: left
      full_name: "Sofle Choc Pro Left"
    - name: right
      full_name: "Sofle Choc Pro Right"
```

## config/boards/arm/sofle_choc_pro/board.yml
```yaml
board:
  name: sofle_choc_pro
  vendor: custom
  soc: nrf52840
  identifier: sofle_choc_pro
  type: board
  arch: arm
  revisions:
    - name: left
    - name: right
```

## config/boards/arm/sofle_choc_pro_left/Kconfig
```kconfig
if BOARD_SOFLE_CHOC_PRO_LEFT

config BOARD
    default "sofle_choc_pro_left"

# Wir lassen ZMK/Zephyr hier die Arbeit machen und fügen KEINE source-Befehle ein.

endif
```

## config/boards/arm/sofle_choc_pro_left/Kconfig.board
```kconfig
config BOARD_SOFLE_CHOC_PRO_LEFT
    bool "sofle_choc_pro_left"
    depends on SOC_NRF52840_QIAA
    select SOC_SERIES_NRF52X
    select SOC_FAMILY_NRF
```

## config/boards/arm/sofle_choc_pro_left/Kconfig.defconfig
```kconfig
if BOARD_SOFLE_CHOC_PRO_LEFT

config BOARD
    default "sofle_choc_pro_left"

config ZMK_KEYBOARD_NAME
    default "Sofle Choc Pro"

# Wichtig: Falls du hier ein "source" stehen hast, das mit boards/arm/ beginnt: LÖSCHEN.
endif
```

## config/boards/arm/sofle_choc_pro_left/board.yml
```yaml
board:
  name: "sofle_choc_pro_left"
  vendor: "custom"
  soc: "nrf52840"
  identifier: "sofle_choc_pro_left"
  type: "board"
  arch: "arm"
```

## config/boards/arm/sofle_choc_pro_right/Kconfig.defconfig
```kconfig
if BOARD_SOFLE_CHOC_PRO_RIGHT

config BOARD
    default "sofle_choc_pro_right"

# Das ist wichtig, damit die nRF52840 Einstellungen geladen werden
source "boards/arm/sofle_choc_pro_right/Kconfig.defconfig"

endif
```

## config/boards/arm/sofle_choc_pro_right/board.yml
```yaml
board:
  name: sofle_choc_pro_right
  vendor: custom
  soc: nrf52840
  identifier: sofle_choc_pro_right
  type: board
  arch: arm
```

## config/boards/sofle_choc_pro/Kconfig
```kconfig
config BOARD_SOFLE_CHOC_PRO_LEFT
    bool "Sofle Choc Pro Left"
    depends on SOC_NRF52840_QIAA
```

## config/boards/sofle_choc_pro/Kconfig.defconfig
```kconfig
if BOARD_SOFLE_CHOC_PRO_LEFT || BOARD_SOFLE_CHOC_PRO_RIGHT

config BOARD
    default "sofle_choc_pro_left" if BOARD_SOFLE_CHOC_PRO_LEFT
    default "sofle_choc_pro_right" if BOARD_SOFLE_CHOC_PRO_RIGHT

config DT_HAS_NORDIC_NRF52840_QIAA_ENABLED
    def_bool y

endif
```

## config/shields/nice_view_disp/Kconfig.shield
```kconfig
config SHIELD_SOFLE_PRO_VIEW
    def_bool $(shields_list_contains,sofle_pro_view)
```

## config/west.yml
```yaml
manifest:
  remotes:
    - name: zmkfirmware
      url-base: https://github.com/zmkfirmware
  projects:
    - name: zmk
      remote: zmkfirmware
      revision: v0.3
      import: app/west.yml
    # Pointing Modul hinzufügen:
    - name: zmk-pointing
      remote: zmkfirmware
      revision: main
```

## shields/nice_view_disp/Kconfig.shield
```kconfig
config SHIELD_NICE_VIEW_DISP
    def_bool $(shields_list_contains,nice_view_disp)
```
